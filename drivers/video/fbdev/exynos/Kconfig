## drivers/video/fbdev/exynos/Kconfig
```kconfig
if SOC_EXYNOS8895

source "drivers/video/fbdev/exynos/dpu/Kconfig"
source "drivers/video/fbdev/exynos/panel/Kconfig"

endif # SOC_EXYNOS8895

if SOC_EXYNOS9810

source "drivers/video/fbdev/exynos/dpu_9810/Kconfig"
source "drivers/video/fbdev/exynos/panel_9810/Kconfig"

endif # SOC_EXYNOS9810
```
